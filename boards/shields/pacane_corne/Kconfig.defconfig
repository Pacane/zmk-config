## boards/shields/pacane_corne/Kconfig.defconfig
```kconfig
if SHIELD_PACANE_CORNE_LEFT

config ZMK_KEYBOARD_NAME
    default "Corne Pacane"

config ZMK_SPLIT_ROLE_CENTRAL
    default y

endif

if SHIELD_PACANE_CORNE_LEFT || SHIELD_PACANE_CORNE_RIGHT

config ZMK_SPLIT
    default y

endif
```

## boards/shields/pacane_corne/Kconfig.shield
```kconfig
# Copyright (c) 2020 Pete Johanson
# SPDX-License-Identifier: MIT

config SHIELD_PACANE_CORNE_LEFT
    def_bool $(shields_list_contains,pacane_corne_left)

config SHIELD_PACANE_CORNE_RIGHT
    def_bool $(shields_list_contains,pacane_corne_right)
```

## boards/shields/pacane_dongle/Kconfig.defconfig
```kconfig
if SHIELD_PACANE_DONGLE

config ZMK_KEYBOARD_NAME
    default "Pacane"

config ZMK_SPLIT_ROLE_CENTRAL
    default y

config ZMK_SPLIT_BLE_CENTRAL_PERIPHERALS
    default 2

endif

if SHIELD_PACANE_DONGLE || SHIELD_PACANE_DONGLE_LEFT

config ZMK_SPLIT
    default y

endif
```

## boards/shields/pacane_dongle/Kconfig.shield
```kconfig
config SHIELD_PACANE_DONGLE
    def_bool $(shields_list_contains,pacane_dongle)

config SHIELD_PACANE_DONGLE_LEFT
    def_bool $(shields_list_contains,pacane_dongle_left)
```
