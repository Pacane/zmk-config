#include "pacino_pcb.dtsi"

/*
 * Left half: parts (hot-swap sockets, diodes) on the board's BACK face, controller on the FRONT --
 * the case puts the nano on top of the board, component side down, flush in the plate window, and
 * the nano's two pin rows land the other way round from the pacino README's "left half" column.
 * These are that README's *right*-half pins.  Bridge JP1 / JP2 to the pad marked R (the mark on the
 * face the nano sits on).
 */

&kscan0 {
    row-gpios
        = <&pro_micro 2 (GPIO_ACTIVE_HIGH | GPIO_PULL_DOWN)>    /* row 0: top    */
        , <&pro_micro 3 (GPIO_ACTIVE_HIGH | GPIO_PULL_DOWN)>    /* row 1: home   */
        , <&pro_micro 4 (GPIO_ACTIVE_HIGH | GPIO_PULL_DOWN)>    /* row 2: bottom */
        , <&pro_micro 5 (GPIO_ACTIVE_HIGH | GPIO_PULL_DOWN)>    /* row 3: extras */
        , <&pro_micro 9 (GPIO_ACTIVE_HIGH | GPIO_PULL_DOWN)>    /* row 4: thumbs */
        ;
    /* COL0 .. COL4 = pinky .. inner, which is the order the transform wants for the left half */
    col-gpios
        = <&pro_micro 21 GPIO_ACTIVE_HIGH>   /* col 0: pinky  (COL0) */
        , <&pro_micro 20 GPIO_ACTIVE_HIGH>   /* col 1: ring   (COL1) */
        , <&pro_micro 19 GPIO_ACTIVE_HIGH>   /* col 2: middle (COL2) */
        , <&pro_micro 18 GPIO_ACTIVE_HIGH>   /* col 3: index  (COL3) */
        , <&pro_micro 10 GPIO_ACTIVE_HIGH>   /* col 4: inner  (COL4) */
        ;
};
